## build/conf/bblayers.conf
```bitbake
BBLAYERS ?= " \
    ${TOPDIR}/../sources/meta-arm/meta-arm \
    ${TOPDIR}/../sources/meta-arm/meta-arm-toolchain \
    ${TOPDIR}/../sources/meta-openambedded/meta-filesystems \
    ${TOPDIR}/../sources/meta-openambedded/meta-multimedia \
    ${TOPDIR}/../sources/meta-openambedded/meta-networking \
    ${TOPDIR}/../sources/meta-openambedded/meta-oe \
    ${TOPDIR}/../sources/meta-openambedded/meta-python \
    ${TOPDIR}/../sources/meta-rauc \
    ${TOPDIR}/../sources/meta-schneios \
    ${TOPDIR}/../sources/meta-xilinx/meta-xilinx-core \
    ${TOPDIR}/../sources/meta-xilinx/meta-xilinx-standalone \
    ${TOPDIR}/../sources/meta-yocto/meta-poky \
    ${TOPDIR}/../sources/meta-yocto/meta-yocto-bsp \
    ${TOPDIR}/../sources/openembedded-core/meta"
BBPATH ?= "${TOPDIR}"
BBFILES ??= ""
```

## build/conf/local.conf
```bitbake
MACHINE ??= "zynq-generic-schneios"
DISTRO ??= "schneios"
BBMULTICONFIG ?= ""

#MACHINE = "rpi4-schneios"
# MACHINE = "zynq-generic-schneios"

# DISTRO = "schneios"

# LICENSE_FLAGS_ACCEPTED += "xilinx"

# BBMULTICONFIG += 'fsbl-fw'


# XILINX_WITH_ESW = "generic"
```
